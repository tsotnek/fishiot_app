## boards/arm/iof_nrf9160_ns_new/Kconfig.board
```kconfig
# Copyright (c) 2024 Nordic Semiconductor ASA
# SPDX-License-Identifier: Apache-2.0

config BOARD_IOF_NRF9160_NS_NEW
	bool "IoF nRF9160 ns new"
	depends on SOC_NRF9160_SICA
```

## boards/arm/iof_nrf9160_ns_new/Kconfig.defconfig
```kconfig
# Copyright (c) 2024 Nordic Semiconductor ASA
# SPDX-License-Identifier: Apache-2.0

if BOARD_IOF_NRF9160_NS_NEW

config BOARD
	default "iof_nrf9160_ns_new"


endif
```

## boards/arm/iof_nrf9160_ns_new/iof_nrf9160_ns_new_defconfig
```kconfig
# Copyright (c) 2024 Nordic Semiconductor ASA
# SPDX-License-Identifier: Apache-2.0

CONFIG_SOC_SERIES_NRF91X=y
CONFIG_SOC_NRF9160_SICA=y
CONFIG_BOARD_IOF_NRF9160_NS_NEW=y

# Enable MPU
CONFIG_ARM_MPU=y

# Enable hardware stack protection
CONFIG_HW_STACK_PROTECTION=y

# Enable TrustZone-M
CONFIG_ARM_TRUSTZONE_M=y
CONFIG_BUILD_WITH_TFM=y
CONFIG_TRUSTED_EXECUTION_NONSECURE=y
#Enable RTT
CONFIG_USE_SEGGER_RTT=y

#Enable GPIO
CONFIG_GPIO=y

#Enable UART
CONFIG_SERIAL=y

#enable console
CONFIG_CONSOLE=y
CONFIG_UART_CONSOLE=y
#additional board options
CONFIG_PINCTRL=y
```
